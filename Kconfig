## Kconfig
```kconfig
menuconfig RUNTIME_BLE
	bool "runtime-ble: trouble-based loadable BLE runtime (prebuilt staticlib)"
	default n
	depends on !BT
	select DYNAMIC_THREAD
	select DYNAMIC_THREAD_ALLOC
	select DYNAMIC_INTERRUPTS
	select HWINFO
	help
	  trouble (Rust) BLE host + nRF SoftDevice Controller, packaged as a per-chip
	  prebuilt staticlib (lib/<chip>/libruntime_ble.a) plus the Zephyr glue
	  (glue/glue.c). It exposes a generic Nordic-UART-style GATT peripheral
	  (RX write + TX notify) via a small C API (include/runtime_ble.h).

	  The library OWNS the radio, so the application MUST build with CONFIG_BT=n
	  and CONFIG_MPSL=n (enforced by `depends on !BT`). Runtime state is
	  heap-allocated on runtime_ble_load() and freed on runtime_ble_unload(), so
	  it costs ~no RAM until loaded. Set CONFIG_HEAP_MEM_POOL_SIZE large enough to
	  hold one session (the minimum default build is ~28 KB incl. the dynamic thread
	  stack; the perf/central builds are larger), and select the dynamic-stack-from-
	  heap strategy with CONFIG_DYNAMIC_THREAD_PREFER_ALLOC=y (a choice symbol, so it
	  must be set in the application prj.conf).

if RUNTIME_BLE

config RUNTIME_BLE_THREAD_STACK_SIZE
	int "BLE runtime thread stack size (bytes)"
	default 32768 if RUNTIME_BLE_PERF
	default 32768 if RUNTIME_BLE_CENTRAL
	default 32768 if RUNTIME_BLE_L2CAP
	default 20480
	range 16384 65536
	help
	  Dynamic stack (k_thread_stack_alloc) for the thread that runs the trouble
	  async host. Steady-state high-water is ~14 KB, but the MPSL/SDC C-library
	  init transient is deeper. The minimum default build has a smaller controller
	  init, so its measured high-water is ~15 KB (HW, advertising + a connection)
	  and it defaults to 20480; the full builds (perf/central/l2cap) default to
	  32768 (24576 is the tested minimum there). Raise it if you do deep work on
	  this thread (heavy pairing, large notifications, significant app callbacks).
	  Allocated from the heap on load, freed on unload.

config RUNTIME_BLE_THREAD_PRIORITY
	int "BLE runtime thread priority"
	default 5
	range 0 15
	help
	  Preemptible priority (K_PRIO_PREEMPT) for the BLE runtime thread.

config RUNTIME_BLE_CENTRAL
	bool "Enable the central role (scan/connect + GATT client)"
	default n
	help
	  Links the central-capable prebuilt staticlib
	  (lib/<chip>/libruntime_ble_central.a) and enables the central API
	  (runtime_ble_scan_start / runtime_ble_connect / runtime_ble_client_*).

	  Off by default so peripheral-only apps stay lean: the central role adds
	  the scan/central SoftDevice Controller features (extra flash/RAM). The
	  matching staticlib must exist for the target chip — build it with the
	  `central` Cargo feature (see rust/README.md).

config RUNTIME_BLE_L2CAP
	bool "Enable L2CAP connection-oriented channels (CoC)"
	default n
	help
	  Links a l2cap-capable prebuilt staticlib (the lib filename gains a
	  "_l2cap" suffix) and enables the L2CAP API (runtime_ble_l2cap_send +
	  the on_l2cap_* callbacks). Once connected, a peripheral listens on
	  config.l2cap_psm and a central opens a channel to it.

	  Off by default. Combine with CONFIG_RUNTIME_BLE_CENTRAL for a central
	  that opens channels. The matching staticlib must exist for the target
	  chip — build it with the `l2cap` Cargo feature (see rust/README.md).

config RUNTIME_BLE_PERF
	bool "Full-featured peripheral (large buffers + all advertising modes)"
	default n
	depends on !RUNTIME_BLE_CENTRAL && !RUNTIME_BLE_L2CAP
	help
	  Links the full peripheral staticlib (lib/<chip>/libruntime_ble_perf.a) instead
	  of the minimum default. It restores the heavy optional SoftDevice Controller
	  features (extended + periodic advertising, Coded PHY, connection subrating,
	  frame-space update, LE extended feature set), the large 251-byte ATT/L2CAP
	  buffers, the 244-byte characteristic value length and the 64-entry attribute
	  table — at the cost of ~20 KB more RAM.

	  Leave it OFF (the default) for minimum RAM: a legacy-advertising peripheral +
	  GATT server with small buffers (128-byte values, 32-entry table), which is
	  enough for most sensors/beacons. central/l2cap builds already include the full
	  feature set, so this option is peripheral-only. The matching staticlib must
	  exist for the target chip — build it with the `perf` Cargo feature (see
	  rust/README.md).

endif # RUNTIME_BLE
```

## examples/nrf52832/west.yml
```yaml
# Standalone west manifest for the runtime-ble "nrf52832" example.
#
# The example is independent of the library repo: it pulls Zephyr AND the
# zephyr-runtime-ble module via git, so it builds with NO -DZEPHYR_EXTRA_MODULES
# (west auto-discovers zephyr-runtime-ble as a module via its zephyr/module.yml).
#
#   west init -l nrf52832        # use this example as the manifest (it must be a git repo)
#   west update            # clones Zephyr + zephyr-runtime-ble
#   west build -b <board> nrf52832
manifest:
  remotes:
    - name: zephyrproject
      url-base: https://github.com/zephyrproject-rtos
    - name: tuemb
      url-base: https://github.com/TuEmb

  projects:
    # Not tied to a Zephyr version: the module uses only stable APIs + a prebuilt
    # staticlib (verified on 4.1.x-4.4.x). This is just the release this example
    # pins -- change it to whatever you build against.
    - name: zephyr
      remote: zephyrproject
      revision: v4.4.1
      import: true
    - name: zephyr-runtime-ble
      remote: tuemb
      revision: main
      path: modules/zephyr-runtime-ble

  self:
    path: nrf52832
```

## examples/nrf54l15_l2cap_peripheral/west.yml
```yaml
# Standalone west manifest for the runtime-ble L2CAP echo peripheral example.
#
#   west init -l nrf54l15_l2cap_peripheral
#   west update
#   west build -b xiao_nrf54l15/nrf54l15/cpuapp nrf54l15_l2cap_peripheral
#   west flash
manifest:
  remotes:
    - name: zephyrproject
      url-base: https://github.com/zephyrproject-rtos
    - name: tuemb
      url-base: https://github.com/TuEmb

  projects:
    # Not tied to a Zephyr version: the module uses only stable APIs + a prebuilt
    # staticlib (verified on 4.1.x-4.4.x). This is just the release this example
    # pins -- change it to whatever you build against.
    - name: zephyr
      remote: zephyrproject
      revision: v4.4.1
      import: true
    - name: zephyr-runtime-ble
      remote: tuemb
      revision: main
      path: modules/zephyr-runtime-ble

  self:
    path: nrf54l15_l2cap_peripheral
```

## examples/nrf54lm20/west.yml
```yaml
# Standalone west manifest for the runtime-ble "nrf54lm20" example.
#
# The example is independent of the library repo: it pulls Zephyr AND the
# zephyr-runtime-ble module via git, so it builds with NO -DZEPHYR_EXTRA_MODULES
# (west auto-discovers zephyr-runtime-ble as a module via its zephyr/module.yml).
#
#   west init -l nrf54lm20        # use this example as the manifest (it must be a git repo)
#   west update            # clones Zephyr v4.4.1 + zephyr-runtime-ble
#   west build -b <board> nrf54lm20
manifest:
  remotes:
    - name: zephyrproject
      url-base: https://github.com/zephyrproject-rtos
    - name: tuemb
      url-base: https://github.com/TuEmb

  projects:
    - name: zephyr
      remote: zephyrproject
      revision: v4.4.1
      import: true
    - name: zephyr-runtime-ble
      remote: tuemb
      revision: main
      path: modules/zephyr-runtime-ble

  self:
    path: nrf54lm20
```
