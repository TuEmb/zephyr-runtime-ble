## CMakeLists.txt
```
cmake_minimum_required(VERSION 3.20.0)
find_package(Zephyr REQUIRED HINTS $ENV{ZEPHYR_BASE})
project(runtime_ble_test)

# runtime-ble is discovered as a Zephyr module via west (see west.yml), so no
# -DZEPHYR_EXTRA_MODULES is needed. Build + flash + run, e.g.:
#   west build -b xiao_nrf54l15/nrf54l15/cpuapp test
#   west flash
# then read the ztest output on the console.
target_sources(app PRIVATE
  src/test_support.c
  src/test_lifecycle.c
  src/test_edge.c
  src/test_stress.c
)
```

## west.yml
```
# Standalone west manifest for the runtime-ble on-target test suite.
#
# Like the examples, the test app is independent of the library repo: it pulls
# Zephyr AND the zephyr-runtime-ble module via git, so it builds with NO
# -DZEPHYR_EXTRA_MODULES (west auto-discovers the module via zephyr/module.yml).
#
#   west init -l test        # use this dir as the manifest (must be a git repo)
#   west update              # clones Zephyr + zephyr-runtime-ble
#   west build -b xiao_nrf54l15/nrf54l15/cpuapp test
#   west flash
#
# To test LOCAL (uncommitted) changes to the library, point the
# zephyr-runtime-ble project's `revision` at your branch, or build the test
# inside a workspace where the repo is the local module.
manifest:
  remotes:
    - name: zephyrproject
      url-base: https://github.com/zephyrproject-rtos
    - name: tuemb
      url-base: https://github.com/TuEmb

  projects:
    # Not tied to a Zephyr version: the module uses only stable APIs + a prebuilt
    # staticlib (verified on 4.1.x-4.4.x). This is just the release this example
    # pins -- change it to whatever you build against.
    - name: zephyr
      remote: zephyrproject
      revision: v4.4.1
      import: true
    - name: zephyr-runtime-ble
      remote: tuemb
      revision: main
      path: modules/zephyr-runtime-ble

  self:
    path: test
```

## prj.conf
```kconfig
# runtime-ble on-target test suite (ztest). Target: nRF54L15 hardware.
CONFIG_ZTEST=y
CONFIG_ZTEST_STACK_SIZE=4096

# --- runtime-ble (trouble + SoftDevice Controller, owns the radio) ---
CONFIG_RUNTIME_BLE=y
CONFIG_BT=n
# Allocate the per-session thread stack from the system heap too, so the leak
# check sees (and verifies the return of) the whole session footprint.
CONFIG_DYNAMIC_THREAD_PREFER_ALLOC=y
# Headroom for repeated load/unload cycles plus the measurement.
CONFIG_HEAP_MEM_POOL_SIZE=131072
CONFIG_MAIN_STACK_SIZE=4096

# Heap free-byte accounting used by the stress (no-leak) test.
CONFIG_SYS_HEAP_RUNTIME_STATS=y

# --- console / logging ---
CONFIG_PRINTK=y
CONFIG_LOG=y
CONFIG_LOG_MODE_IMMEDIATE=y
CONFIG_SERIAL=y
CONFIG_CONSOLE=y
CONFIG_UART_CONSOLE=y
CONFIG_THREAD_NAME=y

# Print fault dumps to the console rather than silently resetting.
CONFIG_EXCEPTION_DEBUG=y
```

## src/test_edge.c
```c
/*
 * Edge cases: API calls made out of the expected order or with bad arguments
 * must fail gracefully (a documented error code) and never crash the device.
 *
 * Precondition note: runtime_ble_load() reads the config captured by
 * runtime_ble_init(); calling load() with no prior init is undefined (it
 * faults). Every suite therefore inits in setup, so "load before init" is not
 * exercised here — it is a documented precondition, not a supported path.
 */
#include <zephyr/ztest.h>
#include <zephyr/kernel.h>

#include "runtime_ble.h"
#include "test_support.h"

static void *edge_setup(void)
{
	zassert_equal(runtime_ble_init(test_base_cfg()), RUNTIME_BLE_OK, "init failed");
	return NULL;
}

static void on_client_status(uint8_t op, int8_t status, uint16_t handle, void *user)
{
	ARG_UNUSED(op);
	ARG_UNUSED(status);
	ARG_UNUSED(handle);
	ARG_UNUSED(user);
}

static void on_descriptor_write(uint16_t handle, uint16_t chr, uint8_t desc,
				const uint8_t *data, size_t len, void *user)
{
	ARG_UNUSED(handle);
	ARG_UNUSED(chr);
	ARG_UNUSED(desc);
	ARG_UNUSED(data);
	ARG_UNUSED(len);
	ARG_UNUSED(user);
}

static void on_security_state(uint8_t level, uint8_t key_len, uint8_t flags, void *user)
{
	ARG_UNUSED(level);
	ARG_UNUSED(key_len);
	ARG_UNUSED(flags);
	ARG_UNUSED(user);
}

static void on_write_ext(uint16_t chr, uint16_t offset, const uint8_t *data, size_t len,
			 void *user)
{
	ARG_UNUSED(chr);
	ARG_UNUSED(offset);
	ARG_UNUSED(data);
	ARG_UNUSED(len);
	ARG_UNUSED(user);
}

static void on_descriptor_write_ext(uint16_t handle, uint16_t chr, uint8_t desc,
				    uint16_t offset, const uint8_t *data, size_t len,
				    void *user)
{
	ARG_UNUSED(handle);
	ARG_UNUSED(chr);
	ARG_UNUSED(desc);
	ARG_UNUSED(offset);
	ARG_UNUSED(data);
	ARG_UNUSED(len);
	ARG_UNUSED(user);
}

ZTEST_SUITE(runtime_ble_edge, NULL, edge_setup, NULL, NULL, NULL);

ZTEST(runtime_ble_edge, test_init_null_is_rejected)
{
	zassert_equal(runtime_ble_init(NULL), RUNTIME_BLE_ERR_INVALID, "NULL cfg must be rejected");
	/* Restore a valid config for the rest of the suite. */
	zassert_equal(runtime_ble_init(test_base_cfg()), RUNTIME_BLE_OK, "re-init failed");
}

/* Unloading when nothing is loaded is a no-op OK. */
ZTEST(runtime_ble_edge, test_unload_without_load)
{
	zassert_equal(runtime_ble_unload(), RUNTIME_BLE_OK, "unload with nothing loaded must be OK");
}

/* Unloading twice is a no-op OK on the second call. */
ZTEST(runtime_ble_edge, test_double_unload)
{
	test_load_settled();
	zassert_equal(runtime_ble_unload(), RUNTIME_BLE_OK, "1st unload failed");
	zassert_equal(runtime_ble_unload(), RUNTIME_BLE_OK, "2nd unload must be a no-op OK");
}

/* Bad send arguments are rejected without touching the queue. */
ZTEST(runtime_ble_edge, test_send_argument_validation)
{
	const uint8_t buf[4] = {1, 2, 3, 4};

	zassert_equal(runtime_ble_send(NULL, 4), RUNTIME_BLE_ERR_INVALID, "NULL data");
	zassert_equal(runtime_ble_send(buf, 0), RUNTIME_BLE_ERR_INVALID, "zero length");
	zassert_equal(runtime_ble_send(buf, 100000), RUNTIME_BLE_ERR_INVALID, "oversized length");
}

ZTEST(runtime_ble_edge, test_indicate_argument_validation)
{
	const uint8_t buf[4] = {1, 2, 3, 4};

	zassert_equal(runtime_ble_indicate(0, NULL, 4), RUNTIME_BLE_ERR_INVALID, "NULL data");
	zassert_equal(runtime_ble_indicate(0, buf, 0), RUNTIME_BLE_ERR_INVALID, "zero length");
	zassert_equal(runtime_ble_indicate(0, buf, 100000), RUNTIME_BLE_ERR_INVALID,
		      "oversized length");
}

ZTEST(runtime_ble_edge, test_security_argument_validation)
{
	zassert_equal(runtime_ble_passkey_input(1000000), RUNTIME_BLE_ERR_INVALID,
		      "passkey must be a 6-digit value");
	zassert_equal(runtime_ble_set_io_capability(6), RUNTIME_BLE_ERR_INVALID,
		      "unknown IO capability must be rejected");
}

ZTEST(runtime_ble_edge, test_l2cap_config_validation)
{
	runtime_ble_config_t cfg = *test_base_cfg();

	cfg.l2cap.credit_policy = 2;
	zassert_equal(runtime_ble_init(&cfg), RUNTIME_BLE_ERR_INVALID,
		      "unknown L2CAP credit policy must be rejected");

	cfg = *test_base_cfg();
	cfg.l2cap.mtu = 22;
	zassert_equal(runtime_ble_init(&cfg), RUNTIME_BLE_ERR_INVALID,
		      "too-small L2CAP MTU must be rejected");

	cfg = *test_base_cfg();
	cfg.l2cap.mps = 22;
	zassert_equal(runtime_ble_init(&cfg), RUNTIME_BLE_ERR_INVALID,
		      "too-small L2CAP MPS must be rejected");

	zassert_equal(runtime_ble_init(test_base_cfg()), RUNTIME_BLE_OK, "restore base cfg failed");
}

ZTEST(runtime_ble_edge, test_adv_filter_policy_validation)
{
	static const uint8_t peer[6] = {0, 1, 2, 3, 4, 5};
	runtime_ble_config_t cfg = *test_base_cfg();

	cfg.adv.filter_policy = 4;
	cfg.adv.accept_address = peer;
	zassert_equal(runtime_ble_init(&cfg), RUNTIME_BLE_ERR_INVALID,
		      "unknown advertising filter policy must be rejected");

	cfg = *test_base_cfg();
	cfg.adv.filter_policy = RUNTIME_BLE_ADV_FILTER_CONN;
	zassert_equal(runtime_ble_init(&cfg), RUNTIME_BLE_ERR_INVALID,
		      "filter policy must require an accept-list address");

	cfg.adv.accept_address = peer;
	zassert_equal(runtime_ble_init(&cfg), RUNTIME_BLE_OK,
		      "filter policy with an accept-list address should initialize");
	zassert_equal(runtime_ble_init(test_base_cfg()), RUNTIME_BLE_OK, "restore base cfg failed");
}

ZTEST(runtime_ble_edge, test_central_indicate_subscribe_requires_central_lib)
{
	zassert_equal(runtime_ble_client_subscribe_indicate(1), RUNTIME_BLE_ERR_INVALID,
		      "default peripheral lib must reject central indication subscribe");
	zassert_equal(runtime_ble_client_unsubscribe(1), RUNTIME_BLE_ERR_INVALID,
		      "default peripheral lib must reject central unsubscribe");
}

ZTEST(runtime_ble_edge, test_central_read_blob_requires_central_lib)
{
	const uint8_t uuid[2] = {0x0a, 0x2a};

	zassert_equal(runtime_ble_client_read_blob(1, 4), RUNTIME_BLE_ERR_INVALID,
		      "default peripheral lib must reject central read blob");
	zassert_equal(runtime_ble_client_read_by_uuid(1, 2, uuid, sizeof(uuid)),
		      RUNTIME_BLE_ERR_INVALID,
		      "default peripheral lib must reject central read by UUID");
}

ZTEST(runtime_ble_edge, test_central_descriptor_access_requires_central_lib)
{
	const uint8_t buf[2] = {0x01, 0x00};

	zassert_equal(runtime_ble_client_read_descriptor(1), RUNTIME_BLE_ERR_INVALID,
		      "default peripheral lib must reject descriptor read");
	zassert_equal(runtime_ble_client_read_descriptor_blob(1, 4), RUNTIME_BLE_ERR_INVALID,
		      "default peripheral lib must reject descriptor read blob");
	zassert_equal(runtime_ble_client_write_descriptor(1, buf, sizeof(buf)),
		      RUNTIME_BLE_ERR_INVALID,
		      "default peripheral lib must reject descriptor write");
}

ZTEST(runtime_ble_edge, test_client_status_callback_config_init)
{
	runtime_ble_config_t cfg = *test_base_cfg();

	cfg.callbacks.on_client_status = on_client_status;
	zassert_equal(runtime_ble_init(&cfg), RUNTIME_BLE_OK, "client status callback init failed");
	test_load_settled();
	zassert_equal(runtime_ble_unload(), RUNTIME_BLE_OK, "cleanup unload failed");
	zassert_equal(runtime_ble_init(test_base_cfg()), RUNTIME_BLE_OK, "restore base cfg failed");
}

ZTEST(runtime_ble_edge, test_central_discover_all_requires_central_lib)
{
	zassert_equal(runtime_ble_client_discover_all(), RUNTIME_BLE_ERR_INVALID,
		      "default peripheral lib must reject central discover all");
}

ZTEST(runtime_ble_edge, test_central_discover_services_requires_central_lib)
{
	zassert_equal(runtime_ble_client_discover_services(), RUNTIME_BLE_ERR_INVALID,
		      "default peripheral lib must reject central service discovery");
}

ZTEST(runtime_ble_edge, test_l2cap_disconnect_requires_l2cap_lib)
{
	zassert_equal(runtime_ble_l2cap_disconnect(), RUNTIME_BLE_ERR_INVALID,
		      "default peripheral lib must reject L2CAP disconnect");
}

ZTEST(runtime_ble_edge, test_oob_security_config_init)
{
	runtime_ble_config_t cfg = *test_base_cfg();

	cfg.security.oob_available = 1;
	cfg.security.request_on_connect = 1;
	zassert_equal(runtime_ble_init(&cfg), RUNTIME_BLE_OK, "OOB security config init failed");
	test_load_settled();
	zassert_equal(runtime_ble_unload(), RUNTIME_BLE_OK, "cleanup unload failed");
	zassert_equal(runtime_ble_init(test_base_cfg()), RUNTIME_BLE_OK, "restore base cfg failed");
}

ZTEST(runtime_ble_edge, test_security_state_callback_config_init)
{
	runtime_ble_config_t cfg = *test_base_cfg();

	cfg.callbacks.on_security_state = on_security_state;
	zassert_equal(runtime_ble_init(&cfg), RUNTIME_BLE_OK,
		      "security state callback init failed");
	test_load_settled();
	zassert_equal(runtime_ble_unload(), RUNTIME_BLE_OK, "cleanup unload failed");
	zassert_equal(runtime_ble_init(test_base_cfg()), RUNTIME_BLE_OK, "restore base cfg failed");
}

ZTEST(runtime_ble_edge, test_extended_write_callback_config_init)
{
	runtime_ble_config_t cfg = *test_base_cfg();

	cfg.callbacks.on_write_ext = on_write_ext;
	cfg.callbacks.on_descriptor_write_ext = on_descriptor_write_ext;
	zassert_equal(runtime_ble_init(&cfg), RUNTIME_BLE_OK,
		      "extended write callback init failed");
	test_load_settled();
	zassert_equal(runtime_ble_unload(), RUNTIME_BLE_OK, "cleanup unload failed");
	zassert_equal(runtime_ble_init(test_base_cfg()), RUNTIME_BLE_OK, "restore base cfg failed");
}

ZTEST(runtime_ble_edge, test_gatt_permission_flags_init)
{
	static const uint8_t svc_uuid[16] = {0x9e, 0xca, 0xdc, 0x24, 0x0e, 0xe5, 0xa9, 0xe0,
					     0x93, 0xf3, 0xa3, 0xb5, 0x11, 0x00, 0x4c, 0xe5};
	static const uint8_t chr_uuid[16] = {0x9e, 0xca, 0xdc, 0x24, 0x0e, 0xe5, 0xa9, 0xe0,
					     0x93, 0xf3, 0xa3, 0xb5, 0x12, 0x00, 0x4c, 0xe5};
	static const runtime_ble_char_def_t chars[] = {
		{ .uuid = chr_uuid,
		  .uuid_len = sizeof(chr_uuid),
		  .props = RUNTIME_BLE_PROP_READ | RUNTIME_BLE_PROP_WRITE |
			   RUNTIME_BLE_PROP_NOTIFY,
		  .max_len = 32,
		  .permissions = RUNTIME_BLE_PERM_READ_ENCRYPT |
				 RUNTIME_BLE_PERM_WRITE_AUTH |
				 RUNTIME_BLE_PERM_CCCD_ENCRYPT },
	};
	static const runtime_ble_service_def_t services[] = {
		{ .uuid = svc_uuid, .uuid_len = sizeof(svc_uuid), .chars = chars, .num_chars = 1 },
	};
	runtime_ble_config_t cfg = *test_base_cfg();

	cfg.services = services;
	cfg.num_services = 1;
	cfg.security.bondable = 1;
	zassert_equal(runtime_ble_init(&cfg), RUNTIME_BLE_OK, "permission config init failed");
	test_load_settled();
	zassert_equal(runtime_ble_unload(), RUNTIME_BLE_OK, "cleanup unload failed");
	zassert_equal(runtime_ble_init(test_base_cfg()), RUNTIME_BLE_OK, "restore base cfg failed");
}

ZTEST(runtime_ble_edge, test_gatt_descriptor_config_init)
{
	static const uint8_t svc_uuid[16] = {0x9e, 0xca, 0xdc, 0x24, 0x0e, 0xe5, 0xa9, 0xe0,
					     0x93, 0xf3, 0xa3, 0xb5, 0x21, 0x00, 0x4c, 0xe5};
	static const uint8_t chr_uuid[16] = {0x9e, 0xca, 0xdc, 0x24, 0x0e, 0xe5, 0xa9, 0xe0,
					     0x93, 0xf3, 0xa3, 0xb5, 0x22, 0x00, 0x4c, 0xe5};
	static const uint8_t desc_uuid[2] = {0x01, 0x29};
	static const uint8_t desc_value[] = "test value";
	static const runtime_ble_desc_def_t descs[] = {
		{ .uuid = desc_uuid,
		  .uuid_len = sizeof(desc_uuid),
		  .value = desc_value,
		  .value_len = sizeof(desc_value) - 1 },
	};
	static const runtime_ble_char_def_t chars[] = {
		{ .uuid = chr_uuid,
		  .uuid_len = sizeof(chr_uuid),
		  .props = RUNTIME_BLE_PROP_READ,
		  .max_len = 32,
		  .descriptors = descs,
		  .num_descriptors = 1 },
	};
	static const runtime_ble_service_def_t services[] = {
		{ .uuid = svc_uuid, .uuid_len = sizeof(svc_uuid), .chars = chars, .num_chars = 1 },
	};
	runtime_ble_config_t cfg = *test_base_cfg();

	cfg.services = services;
	cfg.num_services = 1;
	zassert_equal(runtime_ble_init(&cfg), RUNTIME_BLE_OK, "descriptor config init failed");
	test_load_settled();
	zassert_equal(runtime_ble_unload(), RUNTIME_BLE_OK, "cleanup unload failed");
	zassert_equal(runtime_ble_init(test_base_cfg()), RUNTIME_BLE_OK, "restore base cfg failed");
}

ZTEST(runtime_ble_edge, test_gatt_writable_descriptor_config_init)
{
	static const uint8_t svc_uuid[16] = {0x9e, 0xca, 0xdc, 0x24, 0x0e, 0xe5, 0xa9, 0xe0,
					     0x93, 0xf3, 0xa3, 0xb5, 0x31, 0x00, 0x4c, 0xe5};
	static const uint8_t chr_uuid[16] = {0x9e, 0xca, 0xdc, 0x24, 0x0e, 0xe5, 0xa9, 0xe0,
					     0x93, 0xf3, 0xa3, 0xb5, 0x32, 0x00, 0x4c, 0xe5};
	static const uint8_t desc_uuid[2] = {0x80, 0xff};
	static const uint8_t desc_value[] = "rw";
	static const runtime_ble_desc_def_t descs[] = {
		{ .uuid = desc_uuid,
		  .uuid_len = sizeof(desc_uuid),
		  .value = desc_value,
		  .value_len = sizeof(desc_value) - 1,
		  .permissions = RUNTIME_BLE_PERM_WRITE_ALLOWED },
	};
	static const runtime_ble_char_def_t chars[] = {
		{ .uuid = chr_uuid,
		  .uuid_len = sizeof(chr_uuid),
		  .props = RUNTIME_BLE_PROP_READ,
		  .max_len = 32,
		  .descriptors = descs,
		  .num_descriptors = 1 },
	};
	static const runtime_ble_service_def_t services[] = {
		{ .uuid = svc_uuid, .uuid_len = sizeof(svc_uuid), .chars = chars, .num_chars = 1 },
	};
	runtime_ble_config_t cfg = *test_base_cfg();

	cfg.services = services;
	cfg.num_services = 1;
	cfg.callbacks.on_descriptor_write = on_descriptor_write;
	zassert_equal(runtime_ble_init(&cfg), RUNTIME_BLE_OK,
		      "writable descriptor config init failed");
	test_load_settled();
	zassert_equal(runtime_ble_unload(), RUNTIME_BLE_OK, "cleanup unload failed");
	zassert_equal(runtime_ble_init(test_base_cfg()), RUNTIME_BLE_OK, "restore base cfg failed");
}

/* With no session/central, the single outstanding-send slot fills after one
 * queued send; a second send reports the queue is full (no crash, no overwrite).
 * A subsequent load() resets the slot and unload() returns the RAM. */
ZTEST(runtime_ble_edge, test_send_before_load_queues_then_full)
{
	const uint8_t buf[4] = {1, 2, 3, 4};

	zassert_equal(runtime_ble_send(buf, sizeof(buf)), RUNTIME_BLE_OK, "first send should queue");
	zassert_equal(runtime_ble_send(buf, sizeof(buf)), RUNTIME_BLE_ERR_NO_MEM,
		      "second send should report the queue is full");

	test_load_settled();
	zassert_equal(runtime_ble_unload(), RUNTIME_BLE_OK, "cleanup unload failed");
}

/* Notifying a characteristic index that does not exist is accepted at queue
 * time and silently dropped by the session — it must never crash. */
ZTEST(runtime_ble_edge, test_notify_unknown_characteristic)
{
	const uint8_t buf[2] = {0xAB, 0xCD};

	zassert_equal(runtime_ble_notify(0xFFFE, buf, sizeof(buf)), RUNTIME_BLE_OK,
		      "notify to an unknown characteristic should queue without error");

	test_load_settled();
	zassert_equal(runtime_ble_unload(), RUNTIME_BLE_OK, "cleanup unload failed");
}

ZTEST(runtime_ble_edge, test_indicate_unknown_characteristic)
{
	const uint8_t buf[2] = {0xAB, 0xCD};

	zassert_equal(runtime_ble_indicate(0xFFFE, buf, sizeof(buf)), RUNTIME_BLE_OK,
		      "indicate to an unknown characteristic should queue without error");

	test_load_settled();
	zassert_equal(runtime_ble_unload(), RUNTIME_BLE_OK, "cleanup unload failed");
}
```

## src/test_lifecycle.c
```c
/*
 * Lifecycle tests: the normal init -> load -> unload paths, idempotency, and
 * re-loadability (a session can be torn down and brought back up).
 */
#include <zephyr/ztest.h>
#include <zephyr/kernel.h>

#include "runtime_ble.h"
#include "test_support.h"

static void *lifecycle_setup(void)
{
	zassert_equal(runtime_ble_init(test_base_cfg()), RUNTIME_BLE_OK, "init failed");
	return NULL;
}

ZTEST_SUITE(runtime_ble_lifecycle, NULL, lifecycle_setup, NULL, NULL, NULL);

/* The per-device address must be a BLE static-random address (top two bits set). */
ZTEST(runtime_ble_lifecycle, test_addr_is_static_random)
{
	uint8_t a[6] = {0};

	runtime_ble_addr(a);
	zassert_equal(a[5] & 0xC0, 0xC0, "addr 0x..%02x is not a static-random address", a[5]);
}

ZTEST(runtime_ble_lifecycle, test_load_then_unload)
{
	zassert_equal(runtime_ble_load(), RUNTIME_BLE_OK, "load failed");
	k_sleep(K_MSEC(400));
	zassert_equal(runtime_ble_unload(), RUNTIME_BLE_OK, "unload failed");
}

/* Loading twice without an intervening unload is a no-op OK (one session), and
 * a single unload tears that one session down. */
ZTEST(runtime_ble_lifecycle, test_double_load_is_idempotent)
{
	zassert_equal(runtime_ble_load(), RUNTIME_BLE_OK, "1st load failed");
	zassert_equal(runtime_ble_load(), RUNTIME_BLE_OK, "2nd load should be a no-op OK");
	k_sleep(K_MSEC(300));
	zassert_equal(runtime_ble_unload(), RUNTIME_BLE_OK, "unload failed");
}

/* A session can be unloaded and loaded again (the whole point of "loadable"). */
ZTEST(runtime_ble_lifecycle, test_reload_after_unload)
{
	for (int i = 0; i < 2; i++) {
		zassert_equal(runtime_ble_load(), RUNTIME_BLE_OK, "reload %d failed", i);
		k_sleep(K_MSEC(300));
		zassert_equal(runtime_ble_unload(), RUNTIME_BLE_OK, "unload %d failed", i);
	}
}
```

## src/test_stress.c
```c
/*
 * Stress test: many load/unload cycles must neither crash nor leak heap.
 *
 * "No crash" is verified implicitly — a fault would abort the whole run before
 * the assertions are reached. "No leak" is checked by comparing the system-heap
 * free bytes across the cycles: everything a load() allocates, unload() must
 * return, so free should be unchanged (within allocator alignment slop).
 */
#include <zephyr/ztest.h>
#include <zephyr/kernel.h>
#include <zephyr/sys/printk.h>

#include "runtime_ble.h"
#include "test_support.h"

#define STRESS_CYCLES        10
/* Allowance for heap allocator alignment/fragmentation slop. A real per-load
 * leak grows ~linearly with the cycle count and blows past this immediately. */
#define LEAK_TOLERANCE_BYTES 128

static void *stress_setup(void)
{
	zassert_equal(runtime_ble_init(test_base_cfg()), RUNTIME_BLE_OK, "init failed");
	return NULL;
}

ZTEST_SUITE(runtime_ble_stress, NULL, stress_setup, NULL, NULL, NULL);

ZTEST(runtime_ble_stress, test_repeated_load_unload_no_leak)
{
	/* One warm-up cycle absorbs any one-time/lazy allocations so the
	 * measurement isolates the steady-state per-cycle cost. */
	test_load_settled();
	zassert_equal(runtime_ble_unload(), RUNTIME_BLE_OK, "warm-up unload failed");

	const size_t before = test_heap_free();

	for (int i = 0; i < STRESS_CYCLES; i++) {
		zassert_equal(runtime_ble_load(), RUNTIME_BLE_OK, "load failed at cycle %d", i);
		k_sleep(K_MSEC(300));
		zassert_equal(runtime_ble_unload(), RUNTIME_BLE_OK, "unload failed at cycle %d", i);
	}

	const size_t after = test_heap_free();
	const long leaked = (long)before - (long)after;

	printk("[stress] heap free: before=%zu after=%zu  leaked=%ld over %d cycles (%ld B/cycle)\n",
	       before, after, leaked, STRESS_CYCLES, leaked / STRESS_CYCLES);

	zassert_true(leaked <= LEAK_TOLERANCE_BYTES,
		     "leaked %ld bytes over %d load/unload cycles (~%ld B/cycle)",
		     leaked, STRESS_CYCLES, leaked / STRESS_CYCLES);
}
```

## src/test_support.c
```c
/*
 * Shared helpers for the runtime-ble test suites.
 */
#include <zephyr/kernel.h>
#include <zephyr/sys/printk.h>
#include <zephyr/sys/sys_heap.h>

#include "test_support.h"

/* The Zephyr system heap, backing k_aligned_alloc/k_free (what the Rust lib
 * allocates from) and k_thread_stack_alloc (with DYNAMIC_THREAD_PREFER_ALLOC). */
extern struct k_heap _system_heap;

static void on_log(const char *line, void *user)
{
	ARG_UNUSED(user);
	printk("%s\n", line);
}

static void on_subscription(uint16_t chr, uint8_t notify_enabled, uint8_t indicate_enabled,
			    void *user)
{
	ARG_UNUSED(chr);
	ARG_UNUSED(notify_enabled);
	ARG_UNUSED(indicate_enabled);
	ARG_UNUSED(user);
}

static size_t on_bond_load(uint8_t index, uint8_t *out, size_t max_len, void *user)
{
	ARG_UNUSED(index);
	ARG_UNUSED(out);
	ARG_UNUSED(max_len);
	ARG_UNUSED(user);
	return 0;
}

static void on_bond_store(uint8_t index, const uint8_t *blob, size_t len, void *user)
{
	ARG_UNUSED(index);
	ARG_UNUSED(blob);
	ARG_UNUSED(len);
	ARG_UNUSED(user);
}

static uint8_t on_oob_request(uint8_t *local_random, uint8_t *local_confirm, uint8_t *peer_random,
			      uint8_t *peer_confirm, void *user)
{
	ARG_UNUSED(local_random);
	ARG_UNUSED(local_confirm);
	ARG_UNUSED(peer_random);
	ARG_UNUSED(peer_confirm);
	ARG_UNUSED(user);
	return 0;
}

static void on_oob_local_data(const uint8_t *local_random, const uint8_t *local_confirm, void *user)
{
	ARG_UNUSED(local_random);
	ARG_UNUSED(local_confirm);
	ARG_UNUSED(user);
}

static const runtime_ble_config_t cfg = {
	.abi_version = RUNTIME_BLE_ABI_VERSION,
	.device_name = "RTBLE-TEST",
	.adv = {
		.manufacturer_id = 0xFFFF,
		.interval_min_ms = 30,
		.interval_max_ms = 60,
	},
	/* services == NULL -> built-in Nordic UART Service. */
	.callbacks = {
		.on_subscription = on_subscription,
		.on_bond_load = on_bond_load,
		.on_bond_store = on_bond_store,
		.on_oob_request = on_oob_request,
		.on_oob_local_data = on_oob_local_data,
		.on_log = on_log,
	},
};

const runtime_ble_config_t *test_base_cfg(void)
{
	return &cfg;
}

size_t test_heap_free(void)
{
	struct sys_memory_stats st = {0};

	sys_heap_runtime_stats_get(&_system_heap.heap, &st);
	return st.free_bytes;
}

void test_load_settled(void)
{
	(void)runtime_ble_load();
	k_sleep(K_MSEC(400));
}
```

## src/test_support.h
```c
/*
 * Shared helpers for the runtime-ble on-target test suites.
 */
#ifndef RUNTIME_BLE_TEST_SUPPORT_H_
#define RUNTIME_BLE_TEST_SUPPORT_H_

#include <stddef.h>
#include "runtime_ble.h"

/* A minimal, valid config used by every suite: built-in NUS (services == NULL),
 * a name, and a log callback. Static storage — safe to pass to runtime_ble_init. */
const runtime_ble_config_t *test_base_cfg(void);

/* Free bytes currently available in the Zephyr system heap — the heap the
 * runtime allocates its session (and, with PREFER_ALLOC, its thread stack)
 * from. Requires CONFIG_SYS_HEAP_RUNTIME_STATS=y. */
size_t test_heap_free(void);

/* Load a session and wait long enough for the runtime thread to bring MPSL/SDC
 * up and reach the advertising loop, so a following unload exercises a real
 * teardown (not a race against init). */
void test_load_settled(void);

#endif /* RUNTIME_BLE_TEST_SUPPORT_H_ */
```
