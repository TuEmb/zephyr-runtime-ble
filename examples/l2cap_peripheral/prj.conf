## CMakeLists.txt
```
cmake_minimum_required(VERSION 3.20.0)
find_package(Zephyr REQUIRED HINTS $ENV{ZEPHYR_BASE})
project(runtime_ble_l2cap_peripheral)

# Build for any supported board: west build -b <board> l2cap_peripheral
target_sources(app PRIVATE src/main.c)
```

## west.yml
```
# Standalone west manifest for the runtime-ble L2CAP echo peripheral example.
# Build for any supported board (a l2cap-capable lib must exist for it):
#
#   west init -l l2cap_peripheral
#   west update
#   west build -b <board> l2cap_peripheral
#   west flash
manifest:
  remotes:
    - name: zephyrproject
      url-base: https://github.com/zephyrproject-rtos
    - name: tuemb
      url-base: https://github.com/TuEmb

  projects:
    # Not tied to a Zephyr version: the module uses only stable APIs + a prebuilt
    # staticlib (verified on 4.1.x-4.4.x). This is just the release this example
    # pins -- change it to whatever you build against.
    - name: zephyr
      remote: zephyrproject
      revision: v4.4.1
      import: true
    - name: zephyr-runtime-ble
      remote: tuemb
      revision: main
      path: modules/zephyr-runtime-ble

  self:
    path: l2cap_peripheral
```

## prj.conf
```kconfig
# runtime-ble L2CAP echo peripheral — nRF54L15.
CONFIG_RUNTIME_BLE=y
CONFIG_RUNTIME_BLE_L2CAP=y
CONFIG_BT=n
CONFIG_DYNAMIC_THREAD_PREFER_ALLOC=y
CONFIG_HEAP_MEM_POOL_SIZE=131072
CONFIG_RUNTIME_BLE_THREAD_STACK_SIZE=49152
CONFIG_MAIN_STACK_SIZE=4096

CONFIG_PRINTK=y
CONFIG_LOG=y
CONFIG_LOG_MODE_IMMEDIATE=y
CONFIG_SERIAL=y
CONFIG_CONSOLE=y
CONFIG_UART_CONSOLE=y
CONFIG_THREAD_NAME=y
CONFIG_EXCEPTION_DEBUG=y
```

## boards/nrf52840dk_nrf52840.conf
```kconfig
# nRF52 is hard-float: the prebuilt lib is thumbv7em-none-eabihf.
CONFIG_FPU=y
CONFIG_FP_HARDABI=y
```

## boards/nrf52dk_nrf52832.conf
```kconfig
# nRF52 is hard-float: the prebuilt lib is thumbv7em-none-eabihf.
CONFIG_FPU=y
CONFIG_FP_HARDABI=y
# 64 KB RAM: shrink the heap so one session fits.
CONFIG_HEAP_MEM_POOL_SIZE=49152
```

## src/main.c
```c
/*
 * runtime-ble L2CAP echo peripheral.
 *
 * Advertises and listens for an L2CAP connection-oriented channel on
 * config.l2cap_psm; whatever an SDU it receives, it echoes back. Pair it with
 * the L2CAP central example.
 *
 * Requires a l2cap-capable build: CONFIG_RUNTIME_BLE_L2CAP=y.
 */
#include <zephyr/kernel.h>
#include <zephyr/sys/printk.h>
#include "runtime_ble.h"

#define L2CAP_PSM 0x0080

static void on_log(const char *l, void *u)
{
	ARG_UNUSED(u);
	printk("%s\n", l);
}
static void on_l2cap_connected(void *u)
{
	ARG_UNUSED(u);
	printk("[app] L2CAP channel opened\n");
}
static void on_l2cap_disconnected(void *u)
{
	ARG_UNUSED(u);
	printk("[app] L2CAP channel closed\n");
}
static void on_l2cap_data(const uint8_t *d, size_t n, void *u)
{
	ARG_UNUSED(u);
	printk("[app] L2CAP rx len=%u: ", (unsigned int)n);
	for (size_t i = 0; i < n; i++) {
		printk("%c", d[i]);
	}
	printk("  -> echo\n");
	(void)runtime_ble_l2cap_send(d, n); /* echo it back */
}

int main(void)
{
	static const runtime_ble_config_t cfg = {
		.abi_version = RUNTIME_BLE_ABI_VERSION,
		.device_name = "RTBLE-L2CAP",
		.adv = {
			.manufacturer_id = 0xFFFF,
		},
		.l2cap = {
			.psm = L2CAP_PSM,
			.mtu = 128,
			.mps = 64,
			.initial_credits = 4,
			.credit_policy = RUNTIME_BLE_L2CAP_CREDITS_EVERY,
			.credit_policy_value = 2,
		},
		.callbacks = {
			.on_l2cap_connected = on_l2cap_connected,
			.on_l2cap_disconnected = on_l2cap_disconnected,
			.on_l2cap_data = on_l2cap_data,
			.on_log = on_log,
		},
	};
	uint8_t addr[6];

	runtime_ble_addr(addr);
	printk("\n[app] L2CAP echo peripheral, PSM 0x%04x\n", L2CAP_PSM);
	printk("[app] addr %02x:%02x:%02x:%02x:%02x:%02x\n",
	       addr[5], addr[4], addr[3], addr[2], addr[1], addr[0]);
	runtime_ble_init(&cfg);
	if (runtime_ble_load() != RUNTIME_BLE_OK) {
		printk("[app] load failed\n");
		return 0;
	}
	printk("[app] advertising + listening for L2CAP on PSM 0x%04x\n", L2CAP_PSM);
	return 0;
}
```
