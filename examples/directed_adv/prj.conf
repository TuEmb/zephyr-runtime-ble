## CMakeLists.txt
```
cmake_minimum_required(VERSION 3.20.0)
find_package(Zephyr REQUIRED HINTS $ENV{ZEPHYR_BASE})
project(runtime_ble_directed_adv)

target_sources(app PRIVATE src/main.c)
```

## west.yml
```
# Build for any supported board:
#   west init -l directed_adv
#   west update
#   west build -b <board> directed_adv
manifest:
  remotes:
    - name: zephyrproject-rtos
      url-base: https://github.com/zephyrproject-rtos
  projects:
    - name: zephyr
      remote: zephyrproject-rtos
      revision: main
      import:
        name-allowlist:
          - cmsis
          - hal_nordic
          - mbedtls
          - mcuboot
          - nrfxlib
  self:
    path: directed_adv
```

## prj.conf
```kconfig
# runtime-ble directed advertising example. Zephyr BT stays disabled because
# the Rust runtime owns nrf-sdc/MPSL.
CONFIG_RUNTIME_BLE=y
CONFIG_BT=n
CONFIG_DYNAMIC_THREAD_PREFER_ALLOC=y
CONFIG_MAIN_STACK_SIZE=2048
CONFIG_HEAP_MEM_POOL_SIZE=65536

CONFIG_PRINTK=y
CONFIG_LOG=y
CONFIG_LOG_MODE_IMMEDIATE=y
CONFIG_SERIAL=y
CONFIG_CONSOLE=y
CONFIG_UART_CONSOLE=y
CONFIG_THREAD_NAME=y
CONFIG_EXCEPTION_DEBUG=y
```

## src/main.c
```c
/*
 * runtime-ble directed advertising example.
 *
 * Directed advertising is for reconnecting to a known central. Replace
 * peer_addr with the bonded/known central address in little-endian byte order.
 */
#include <zephyr/kernel.h>
#include <zephyr/sys/printk.h>
#include "runtime_ble.h"

/* c0:00:00:00:00:00 as little-endian bytes, static-random address type. */
static const uint8_t peer_addr[6] = {0x00, 0x00, 0x00, 0x00, 0x00, 0xc0};

static void on_log(const char *line, void *user)
{
	ARG_UNUSED(user);
	printk("%s\n", line);
}

static void on_connected(void *user)
{
	ARG_UNUSED(user);
	printk("[app] directed peer connected\n");
}

static void on_disconnected(uint8_t reason, void *user)
{
	ARG_UNUSED(user);
	printk("[app] directed peer disconnected (reason 0x%02x)\n", reason);
}

int main(void)
{
	static const runtime_ble_config_t cfg = {
		.abi_version = RUNTIME_BLE_ABI_VERSION,
		.device_name = "RTBLE-DIRECTED",
		.adv = {
			.directed_peer_address = peer_addr,
			.directed_peer_address_kind = RUNTIME_BLE_ADDR_RANDOM,
			.directed_high_duty = 0,
			.interval_min_ms = 100,
			.interval_max_ms = 150,
		},
		.callbacks = {
			.on_connected = on_connected,
			.on_disconnected = on_disconnected,
			.on_log = on_log,
		},
	};
	uint8_t addr[6];

	runtime_ble_addr(addr);
	printk("\n[app] runtime-ble directed advertising example\n");
	printk("[app] addr %02x:%02x:%02x:%02x:%02x:%02x\n",
	       addr[5], addr[4], addr[3], addr[2], addr[1], addr[0]);
	printk("[app] directed peer c0:00:00:00:00:00\n");

	runtime_ble_init(&cfg);
	if (runtime_ble_load() != RUNTIME_BLE_OK) {
		printk("[app] runtime_ble_load failed\n");
		return 0;
	}
	printk("[app] low-duty directed advertising started\n");
	return 0;
}
```
