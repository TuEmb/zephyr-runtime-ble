## CMakeLists.txt
```
cmake_minimum_required(VERSION 3.20.0)
find_package(Zephyr REQUIRED HINTS $ENV{ZEPHYR_BASE})
project(runtime_ble_gatt_server)

# runtime-ble is discovered as a Zephyr module via west (see west.yml), so no
# -DZEPHYR_EXTRA_MODULES is needed. Build for any supported board, e.g.:
#   west build -b xiao_nrf54l15/nrf54l15/cpuapp gatt_server
#   west build -b nrf52840dk/nrf52840 gatt_server
target_sources(app PRIVATE src/main.c)
```

## west.yml
```
# Standalone west manifest for the runtime-ble GATT-server (peripheral) example.
#
# Organized by feature, not by board — build it for any supported board with
# `west build -b <board> gatt_server` (board-specific tweaks live in boards/).
# It pulls Zephyr AND the zephyr-runtime-ble module via git (NO
# -DZEPHYR_EXTRA_MODULES; west auto-discovers the module via zephyr/module.yml).
#
#   west init -l gatt_server     # use this example as the manifest (a git repo)
#   west update                  # clones Zephyr + zephyr-runtime-ble
#   west build -b <board> gatt_server     # see the README board table
manifest:
  remotes:
    - name: zephyrproject
      url-base: https://github.com/zephyrproject-rtos
    - name: tuemb
      url-base: https://github.com/TuEmb

  projects:
    # Not tied to a Zephyr version: the module uses only stable APIs + a prebuilt
    # staticlib (verified on 4.1.x-4.4.x). This is just the release this example
    # pins -- change it to whatever you build against.
    - name: zephyr
      remote: zephyrproject
      revision: v4.4.1
      import: true
    - name: zephyr-runtime-ble
      remote: tuemb
      revision: main
      path: modules/zephyr-runtime-ble

  self:
    path: gatt_server
```

## prj.conf
```kconfig
# runtime-ble GATT-server (peripheral) example — builds for any supported board.
# Board-specific tweaks (e.g. nRF52 hard-float, nRF52832 RAM) are in boards/.

# --- runtime-ble (trouble + SoftDevice Controller, owns the radio) ---
CONFIG_RUNTIME_BLE=y
# trouble owns the radio -> the Zephyr BT stack and MPSL must be off.
CONFIG_BT=n
# The module selects DYNAMIC_THREAD/_ALLOC; choose the stack-from-heap strategy.
CONFIG_DYNAMIC_THREAD_PREFER_ALLOC=y
# One session (~38 KB incl. the dynamic thread stack) is allocated on load.
CONFIG_HEAP_MEM_POOL_SIZE=65536
CONFIG_MAIN_STACK_SIZE=2048

# --- console / logging ---
CONFIG_PRINTK=y
CONFIG_LOG=y
CONFIG_LOG_MODE_IMMEDIATE=y
CONFIG_SERIAL=y
CONFIG_CONSOLE=y
CONFIG_UART_CONSOLE=y
CONFIG_THREAD_NAME=y

# Print fault dumps to the console rather than silently resetting.
CONFIG_EXCEPTION_DEBUG=y
```

## src/main.c
```c
/*
 * runtime-ble example: a fully user-defined BLE peripheral.
 *
 * Everything is configured from this app — no Rust rebuild:
 *   - advertising: raw ADV payload, scan response name,
 *     interval, discoverable mode
 *   - GATT: a custom 128-bit vendor service with an RX (write) characteristic
 *     and a TX (notify) characteristic.
 *
 * Behaviour: whatever a central writes to RX is echoed back as a notification
 * on TX. Test with the nRF Connect mobile app.
 */
#include <zephyr/kernel.h>
#include <zephyr/sys/printk.h>
#include <string.h>
#include "runtime_ble.h"

/* Custom 128-bit UUIDs, little-endian byte order.
 *   service e54c0001-b5a3-f393-e0a9-e50e24dcca9e
 *   rx      e54c0002-...   (write)
 *   tx      e54c0003-...   (notify)
 */
static const uint8_t svc_uuid[16] = {0x9e, 0xca, 0xdc, 0x24, 0x0e, 0xe5, 0xa9, 0xe0,
				     0x93, 0xf3, 0xa3, 0xb5, 0x01, 0x00, 0x4c, 0xe5};
static const uint8_t rx_uuid[16]  = {0x9e, 0xca, 0xdc, 0x24, 0x0e, 0xe5, 0xa9, 0xe0,
				     0x93, 0xf3, 0xa3, 0xb5, 0x02, 0x00, 0x4c, 0xe5};
static const uint8_t tx_uuid[16]  = {0x9e, 0xca, 0xdc, 0x24, 0x0e, 0xe5, 0xa9, 0xe0,
				     0x93, 0xf3, 0xa3, 0xb5, 0x03, 0x00, 0x4c, 0xe5};
static const uint8_t user_desc_uuid[2] = {0x01, 0x29}; /* Characteristic User Description */
static const uint8_t rw_desc_uuid[2] = {0x80, 0xff};
static const uint8_t rx_desc[] = "client note";
static const uint8_t tx_desc[] = "Echo notifications";
static const runtime_ble_desc_def_t rx_descs[] = {
	{ .uuid = rw_desc_uuid, .uuid_len = sizeof(rw_desc_uuid),
	  .value = rx_desc, .value_len = sizeof(rx_desc) - 1,
	  .permissions = RUNTIME_BLE_PERM_WRITE_ALLOWED },
};
static const runtime_ble_desc_def_t tx_descs[] = {
	{ .uuid = user_desc_uuid, .uuid_len = sizeof(user_desc_uuid),
	  .value = tx_desc, .value_len = sizeof(tx_desc) - 1 },
};

/* Flat characteristic indices, resolved by UUID at runtime (see main()) instead
 * of hard-coding the declaration order — robust to adding/reordering chars. */
static int chr_rx = -1;
static int chr_tx = -1;

static const runtime_ble_char_def_t my_chars[] = {
	{ .uuid = rx_uuid, .uuid_len = 16,
	  .props = RUNTIME_BLE_PROP_WRITE | RUNTIME_BLE_PROP_WRITE_NR, .max_len = 244,
	  .descriptors = rx_descs,
	  .num_descriptors = sizeof(rx_descs) / sizeof(rx_descs[0]) },
	{ .uuid = tx_uuid, .uuid_len = 16,
	  .props = RUNTIME_BLE_PROP_NOTIFY, .max_len = 244,
	  .descriptors = tx_descs,
	  .num_descriptors = sizeof(tx_descs) / sizeof(tx_descs[0]) },
};
static const runtime_ble_service_def_t my_services[] = {
	{ .uuid = svc_uuid, .uuid_len = 16, .chars = my_chars, .num_chars = 2 },
};

/* Raw ADV data: flags + manufacturer data + complete 128-bit service UUID. */
static const uint8_t adv_data[] = {
	2, 0x01, 0x06,
	6, 0xff, 0xff, 0xff, 0x52, 0x42, 0x01,
	17, 0x07, 0x9e, 0xca, 0xdc, 0x24, 0x0e, 0xe5, 0xa9, 0xe0,
	0x93, 0xf3, 0xa3, 0xb5, 0x01, 0x00, 0x4c, 0xe5
};
/* Raw AD structure: Complete Local Name "RUNTIME-BLE" for scan response. */
static const uint8_t scan_rsp[] = {
	12, 0x09, 'R', 'U', 'N', 'T', 'I', 'M', 'E', '-', 'B', 'L', 'E'
};

static uint8_t bond_blob[RUNTIME_BLE_BOND_BLOB_MAX];
static size_t bond_blob_len;

static void on_log(const char *line, void *user)
{
	ARG_UNUSED(user);
	printk("%s\n", line);
}

static void on_connected(void *user)
{
	ARG_UNUSED(user);
	printk("[app] central connected\n");
	(void)runtime_ble_read_rssi();
	(void)runtime_ble_read_security();
	(void)runtime_ble_update_frame_space(0, 0, RUNTIME_BLE_PHY_MASK_1M,
					     RUNTIME_BLE_FRAME_SPACE_ACL_CP |
					     RUNTIME_BLE_FRAME_SPACE_ACL_PC);
	(void)runtime_ble_set_phy(RUNTIME_BLE_PHY_CODED);
	(void)runtime_ble_request_connection_rate(0, 0, 1, 1, 0, 0, 0);
}

static void on_disconnected(uint8_t reason, void *user)
{
	ARG_UNUSED(user);
	printk("[app] central disconnected (reason 0x%02x)\n", reason);
}

static void on_write(uint16_t chr, const uint8_t *data, size_t len, void *user)
{
	ARG_UNUSED(user);
	printk("[app] write chr=%u len=%u -> echo on TX\n", chr, (unsigned int)len);
	if ((int)chr == chr_rx && chr_tx >= 0) {
		(void)runtime_ble_notify((uint16_t)chr_tx, data, len);
	}
}

static void on_descriptor_write(uint16_t handle, uint16_t chr, uint8_t desc,
				const uint8_t *data, size_t len, void *user)
{
	ARG_UNUSED(user);
	ARG_UNUSED(data);
	printk("[app] descriptor write handle=%u chr=%u desc=%u len=%u\n",
	       handle, chr, desc, (unsigned int)len);
}

static void on_subscription(uint16_t chr, uint8_t notify_enabled, uint8_t indicate_enabled,
			    void *user)
{
	ARG_UNUSED(user);
	printk("[app] subscription chr=%u notify=%u indicate=%u\n",
	       chr, notify_enabled, indicate_enabled);
}
static void on_rssi(int8_t rssi, void *user)
{
	ARG_UNUSED(user);
	printk("[app] RSSI %d dBm\n", rssi);
}

static void on_att_mtu(uint16_t att_mtu, void *user)
{
	ARG_UNUSED(user);
	printk("[app] ATT MTU %u\n", att_mtu);
}

static void on_frame_space(uint32_t frame_space_us, void *user)
{
	ARG_UNUSED(user);
	printk("[app] frame space %u us\n", frame_space_us);
}

static void on_connection_rate(uint16_t interval_ms, uint16_t subrate_factor, uint16_t latency,
			       uint16_t continuation_number, uint16_t timeout_ms, void *user)
{
	ARG_UNUSED(user);
	printk("[app] connection rate interval=%u subrate=%u latency=%u cont=%u timeout=%u\n",
	       interval_ms, subrate_factor, latency, continuation_number, timeout_ms);
}

static void on_security_event(uint8_t event, uint8_t level, uint32_t passkey, uint8_t flags,
			      void *user)
{
	ARG_UNUSED(user);
	printk("[app] security event=%u level=%u passkey=%06u flags=0x%02x\n",
	       event, level, passkey, flags);
	if (event == RUNTIME_BLE_SECURITY_PASSKEY_CONFIRM) {
		(void)runtime_ble_passkey_confirm(1);
	}
}

static void on_security_state(uint8_t level, uint8_t key_len, uint8_t flags, void *user)
{
	ARG_UNUSED(user);
	printk("[app] security state level=%u key_len=%u flags=0x%02x\n",
	       level, key_len, flags);
}

static size_t on_bond_load(uint8_t index, uint8_t *out, size_t max_len, void *user)
{
	ARG_UNUSED(user);
	if (index != 0 || bond_blob_len == 0 || max_len < bond_blob_len) {
		return 0;
	}
	memcpy(out, bond_blob, bond_blob_len);
	printk("[app] restored bond blob len=%u\n", (unsigned int)bond_blob_len);
	return bond_blob_len;
}

static void on_bond_store(uint8_t index, const uint8_t *blob, size_t len, void *user)
{
	ARG_UNUSED(user);
	if (index == 0 && len == 0) {
		bond_blob_len = 0;
		printk("[app] cleared bond blob\n");
		return;
	}
	if (index != 0 || len > sizeof(bond_blob)) {
		return;
	}
	memcpy(bond_blob, blob, len);
	bond_blob_len = len;
	printk("[app] stored bond blob len=%u\n", (unsigned int)len);
}

static void on_bond(uint8_t index, const uint8_t *addr, uint8_t addr_kind, uint8_t level,
		    uint8_t key_len, uint8_t flags, void *user)
{
	ARG_UNUSED(user);
	printk("[app] bond index=%u kind=%u addr=%02x:%02x:%02x:%02x:%02x:%02x level=%u key_len=%u flags=0x%02x\n",
	       index, addr_kind, addr[5], addr[4], addr[3], addr[2], addr[1], addr[0],
	       level, key_len, flags);
}

static void on_bond_deleted(uint8_t index, int8_t status, void *user)
{
	ARG_UNUSED(user);
	printk("[app] bond delete index=%u status=%d\n", index, status);
}

int main(void)
{
	static const runtime_ble_config_t cfg = {
		.abi_version = RUNTIME_BLE_ABI_VERSION,
		.device_name = "RUNTIME-BLE",
		.address = NULL,   /* hwinfo-derived static-random address */
		.adv = {
			.data = adv_data,
			.data_len = sizeof(adv_data),
			.scan_response_data = scan_rsp,
			.scan_response_data_len = sizeof(scan_rsp),
			.interval_min_ms = 30,
			.interval_max_ms = 60,
			.discoverable = 0, /* general-discoverable */
		},
		.security = {
			.bondable = 1,
			.io_capability = RUNTIME_BLE_IO_CAP_DISPLAY_YES_NO,
			.bond_slot_count = 1,
		},
		.services = my_services,
		.num_services = 1,
		/* This legacy 1M/2M connectable peripheral never uses the Coded PHY or
		 * connection subrating; trim them from the controller's feature set. */
		.sdc_disable = RUNTIME_BLE_SDC_DISABLE_CODED_PHY |
			       RUNTIME_BLE_SDC_DISABLE_SUBRATING,
		.callbacks = {
			.on_connected = on_connected,
			.on_disconnected = on_disconnected,
			.on_write = on_write,
			.on_descriptor_write = on_descriptor_write,
			.on_subscription = on_subscription,
			.on_rssi = on_rssi,
			.on_att_mtu = on_att_mtu,
			.on_frame_space = on_frame_space,
			.on_connection_rate = on_connection_rate,
			.on_security_event = on_security_event,
			.on_security_state = on_security_state,
			.on_bond_load = on_bond_load,
			.on_bond_store = on_bond_store,
			.on_bond = on_bond,
			.on_bond_deleted = on_bond_deleted,
			.on_log = on_log,
		},
		.user = NULL,
	};

	uint8_t addr[6];

	runtime_ble_addr(addr);
	printk("\n[app] runtime-ble custom-GATT example\n");
	printk("[app] addr %02x:%02x:%02x:%02x:%02x:%02x\n",
	       addr[5], addr[4], addr[3], addr[2], addr[1], addr[0]);

	runtime_ble_init(&cfg);
	/* Resolve characteristic indices by UUID rather than hard-coding them. */
	chr_rx = runtime_ble_char_index(rx_uuid, sizeof(rx_uuid));
	chr_tx = runtime_ble_char_index(tx_uuid, sizeof(tx_uuid));
	printk("[app] resolved chr_rx=%d chr_tx=%d\n", chr_rx, chr_tx);
	if (runtime_ble_load() != RUNTIME_BLE_OK) {
		printk("[app] runtime_ble_load failed\n");
		return 0;
	}
	printk("[app] loaded; advertising \"RUNTIME-BLE\" with a custom vendor service\n");
	return 0;
}
```
