## CMakeLists.txt
```
cmake_minimum_required(VERSION 3.20.0)
find_package(Zephyr REQUIRED HINTS $ENV{ZEPHYR_BASE})
project(runtime_ble_beacon)

target_sources(app PRIVATE src/main.c)
```

## west.yml
```
# Standalone west manifest for the runtime-ble beacon example.
manifest:
  remotes:
    - name: zephyrproject
      url-base: https://github.com/zephyrproject-rtos
    - name: tuemb
      url-base: https://github.com/TuEmb

  projects:
    - name: zephyr
      remote: zephyrproject
      revision: v4.4.1
      import: true
    - name: zephyr-runtime-ble
      remote: tuemb
      revision: main
      path: modules/zephyr-runtime-ble

  self:
    path: beacon
```

## prj.conf
```kconfig
# runtime-ble beacon example. Uses non-connectable advertising only.

CONFIG_RUNTIME_BLE=y
CONFIG_BT=n
CONFIG_DYNAMIC_THREAD_PREFER_ALLOC=y
CONFIG_HEAP_MEM_POOL_SIZE=65536
CONFIG_MAIN_STACK_SIZE=2048

CONFIG_PRINTK=y
CONFIG_LOG=y
CONFIG_LOG_MODE_IMMEDIATE=y
CONFIG_SERIAL=y
CONFIG_CONSOLE=y
CONFIG_UART_CONSOLE=y
CONFIG_THREAD_NAME=y
CONFIG_EXCEPTION_DEBUG=y
```

## src/main.c
```c
/*
 * runtime-ble beacon example.
 *
 * Broadcasts legacy non-connectable advertising with a local name, Service Data,
 * Appearance, TX Power Level, and manufacturer payload in scan response. Scan
 * with a BLE scanner app; this device will not accept connections.
 */
#include <zephyr/kernel.h>
#include <zephyr/sys/printk.h>
#include "runtime_ble.h"

static const uint8_t mfg_data[] = {
	0x08, 0xff,       /* 7 bytes of manufacturer-specific data follow */
	0xff, 0xff,       /* demo company ID, little-endian */
	0x52, 0x42, 0x02, /* "RB", beacon demo version */
	0x00, 0x00        /* app-defined payload bytes */
};
static const uint8_t svc_data_uuid[2] = { 0xF0, 0xFE };
static const uint8_t svc_data[] = {
	0x01, 0x64, 0x2a /* demo frame type, battery %, app sample */
};

static void on_log(const char *line, void *user)
{
	ARG_UNUSED(user);
	printk("%s\n", line);
}

int main(void)
{
	static const runtime_ble_config_t cfg = {
		.abi_version = RUNTIME_BLE_ABI_VERSION,
		.device_name = "RTBLE-BEACON",
		.adv = {
			.service_data_uuid = svc_data_uuid,
			.service_data_uuid_len = sizeof(svc_data_uuid),
			.service_data = svc_data,
			.service_data_len = sizeof(svc_data),
			.appearance = 0x0540, /* Generic sensor */
			.appearance_present = 1,
			.tx_power_dbm = 0,
			.tx_power_present = 1,
			.scan_response_data = mfg_data,
			.scan_response_data_len = sizeof(mfg_data),
			.nonconnectable = 1,
			.interval_min_ms = 100,
			.interval_max_ms = 250,
			.channel_map = RUNTIME_BLE_ADV_CH_ALL,
			.discoverable = 1, /* limited-discoverable beacon */
		},
		.callbacks = {
			.on_log = on_log,
		},
	};

	uint8_t addr[6];

	runtime_ble_addr(addr);
	printk("\n[app] runtime-ble beacon example\n");
	printk("[app] addr %02x:%02x:%02x:%02x:%02x:%02x\n",
	       addr[5], addr[4], addr[3], addr[2], addr[1], addr[0]);

	runtime_ble_init(&cfg);
	if (runtime_ble_load() != RUNTIME_BLE_OK) {
		printk("[app] runtime_ble_load failed\n");
		return 0;
	}
	printk("[app] broadcasting limited-discoverable beacon \"RTBLE-BEACON\"\n");
	return 0;
}
```
